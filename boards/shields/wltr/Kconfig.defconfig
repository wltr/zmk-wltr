## boards/shields/wltr/Kconfig.defconfig
```kconfig
if SHIELD_WLTR_LEFT

config ZMK_KEYBOARD_NAME
    default "WLTR"

config ZMK_SPLIT_ROLE_CENTRAL
    default y

endif

if SHIELD_WLTR_LEFT || SHIELD_WLTR_RIGHT

config ZMK_SPLIT
    default y

endif
```

## boards/shields/wltr/Kconfig.shield
```kconfig
config SHIELD_WLTR_LEFT
    def_bool $(shields_list_contains,wltr_left)

config SHIELD_WLTR_RIGHT
    def_bool $(shields_list_contains,wltr_right)
```
